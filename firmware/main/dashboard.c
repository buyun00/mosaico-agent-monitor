#include "dashboard.h"
#include "dashboard_font.h"
#include "miniz.h"
static unsigned char *glyph_data;
#include "display.h"
#include "quota.h"
#include "config.h"
#include "esp_heap_caps.h"
#include "esp_timer.h"
#include "freertos/FreeRTOS.h"
#include "freertos/semphr.h"
#include <math.h>
#include <string.h>
#include <stdio.h>
#include <stdatomic.h>
#include <stdlib.h>

typedef struct {char name[200],summary[300],state[20],platform[20];} task_t;
typedef struct {char id[20],label[16];int weekly,five_hour,reset;bool has_five_hour;} agent_t;
static struct {task_t tasks[4];agent_t agents[4];char platform[20];int count,agent_count,mic[2],remote;bool available;uint32_t at;} data;
static SemaphoreHandle_t lock;
static uint16_t *canvas,*band,*previous,*text_cache;
typedef struct {int index;uint16_t progress;unsigned char alpha;} border_pixel_t;
static border_pixel_t *border;static int border_count;
static float content_dx;static unsigned content_alpha=255;
static uint16_t fade(uint16_t c,unsigned a){if(a==255)return c;unsigned v=(c>>8)|(c<<8);v=((((v>>11)&31)*a/255)<<11)|((((v>>5)&63)*a/255)<<5)|((v&31)*a/255);return (v>>8)|(v<<8);}
static void border_init(void){
 uint16_t *map=heap_caps_calloc(480*480,2,MALLOC_CAP_SPIRAM);configASSERT(map);
 const float straight=368,arc=42*1.570796327f,quarter=straight+arc,total=quarter*4;
 for(float d=0;d<total;d+=.65f){float path=fmodf(d+84,total);int side=path/quarter;float v=path-side*quarter;float x,y;if(v<straight){x=56+v;y=14;}else {float a=(v-straight)/42-1.570796327f;x=424+42*cosf(a);y=56+42*sinf(a);}float px=x,py=y;if(side==1){px=480-y;py=x;}if(side==2){px=480-x;py=480-y;}if(side==3){px=y;py=480-x;}for(int dy=-6;dy<=6;dy++)for(int dx=-6;dx<=6;dx++)if(dx*dx+dy*dy<=36){int ix=lroundf(px)+dx,iy=lroundf(py)+dy;if(ix>=0&&ix<480&&iy>=0&&iy<480)map[iy*480+ix]=1+(uint16_t)(d/total*65533);}}
 for(int i=0;i<480*480;i++)if(map[i])border_count++;
 border=heap_caps_malloc(border_count*sizeof(*border),MALLOC_CAP_SPIRAM);configASSERT(border);int k=0;for(int i=0;i<480*480;i++)if(map[i]){float old_distance=(map[i]-1)/65533.f*total;float distance_cw=old_distance;if(distance_cw>total-174)continue;map[i]=1+(unsigned)(distance_cw/(total-174)*65533);float qx=fabsf(i%480+.5f-240)-184,qy=fabsf(i/480+.5f-240)-184;float distance=hypotf(fmaxf(qx,0),fmaxf(qy,0))+fminf(fmaxf(qx,qy),0)-42;unsigned a=255*fminf(1,fmaxf(0,5.5f-fabsf(distance)));border[k++]=(border_pixel_t){i,map[i],a};}border_count=k;free(map);
}
static atomic_int rotation,selected;
static int proposed;static uint32_t proposed_at;
static uint16_t color(int r,int g,int b){uint16_t v=((r>>3)<<11)|((g>>2)<<5)|(b>>3);return (v>>8)|(v<<8);}
// Coverage is blended in RGB565; geometry retains fractional positions through rasterization.
static void pixel(int x,int y,uint16_t c,unsigned a){if(x<0||x>=480||y<0||y>=480||!a)return;a=a*content_alpha/255;if(a==255){canvas[y*480+x]=c;return;}unsigned src=(c>>8)|(c<<8),dst=canvas[y*480+x];dst=(dst>>8)|(dst<<8);unsigned v=(((((src>>11)&31)*a+((dst>>11)&31)*(255-a)+127)/255)<<11)|(((((src>>5)&63)*a+((dst>>5)&63)*(255-a)+127)/255)<<5)|(((src&31)*a+(dst&31)*(255-a)+127)/255);canvas[y*480+x]=(v>>8)|(v<<8);}
static void rect(float x,float y,float w,float h,uint16_t c){x+=content_dx;for(int j=floorf(y);j<ceilf(y+h);j++){float ay=fminf(j+1,y+h)-fmaxf(j,y);for(int i=floorf(x);i<ceilf(x+w);i++){float ax=fminf(i+1,x+w)-fmaxf(i,x);pixel(i,j,c,lroundf(255*ax*ay));}}}
static void dot(float x,float y,float r,uint16_t c){x+=content_dx;for(int j=floorf(y-r-1);j<=ceilf(y+r+1);j++)for(int i=floorf(x-r-1);i<=ceilf(x+r+1);i++){float a=fminf(1,fmaxf(0,r+.5f-hypotf(i+.5f-x,j+.5f-y)));pixel(i,j,c,lroundf(a*255));}}
static const unsigned char number_alpha[10][3600]={{0,0,0,0,0,0,0,3,0,0,32,100,159,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0,0},{0,0,0,1,4,0,16,158,253,254,255,252,255,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0,0},{0,0,0,0,0,0,1,2,0,0,64,135,186,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0,0},{0,0,0,0,0,0,1,2,0,1,67,140,189,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0,0},{0,0,0,0,0,0,0,0,0,0,0,0,0,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0,0},{0,0,1,0,20,241,255,254,255,255,255,255,255,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0,0},{0,0,0,0,0,0,0,0,0,0,0,0,3,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0,0},{1,0,15,237,255,254,255,255,255,255,255,255,255,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0,0},{0,0,0,0,0,0,0,1,1,0,1,64,131,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0,0},{0,0,0,0,0,0,2,0,0,13,82,149,190,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0,0}};
static const unsigned char number_advance[10]={33,21,31,32,34,32,31,30,34,31};
static void pretty_number(const char *s,uint16_t c){int x=27;while(*s){int n=*s++-'0';if(n<0||n>9){rect(x,37,19,4,c);x+=25;continue;}for(int y=0;y<60;y++)for(int i=0;i<60;i++)if(number_alpha[n][y*60+i])pixel(x+i,12+y,c,number_alpha[n][y*60+i]);x+=number_advance[n];}}
static void rounded(float x,float y,float w,float h,float radius,uint16_t c){
 float cx=x+w*.5f,cy=y+h*.5f;
 for(int j=(int)y;j<(int)(y+h);j++)for(int i=(int)x;i<(int)(x+w);i++){
  float qx=fabsf(i+.5f-cx)-(w*.5f-radius),qy=fabsf(j+.5f-cy)-(h*.5f-radius);
  float distance=hypotf(fmaxf(qx,0),fmaxf(qy,0))+fminf(fmaxf(qx,qy),0)-radius;
  unsigned a=(unsigned)(255*fminf(1,fmaxf(0,.5f-distance)));
  pixel(i+(int)content_dx,j,c,a);
 }}
static void segmented_bar(float x,float y,int count,float level,uint16_t c){
 const float w=24,h=134,gap=4,sh=(h-gap*(count-1))/count;
 rounded(x-6,y-7,w+12,h+14,17,c);
 rounded(x-4,y-5,w+8,h+10,15,color(20,25,28));
 for(int i=0;i<count;i++){
  float top=y+h-(i+1)*sh-i*gap;
  rounded(x,top,w,sh,fminf(5,sh*.5f),color(53,65,72));
  float amount=fminf(1,fmaxf(0,level*count-i));
  if(amount>0)rounded(x,top+sh*(1-amount),w,sh*amount,fminf(5,sh*amount*.5f),c);
 }
}
static void icon_stroke(float ax,float ay,float bx,float by,float thickness,uint16_t c){
 float dx=bx-ax,dy=by-ay,len=dx*dx+dy*dy;
 for(int y=floorf(fminf(ay,by)-thickness);y<=ceilf(fmaxf(ay,by)+thickness);y++)
 for(int x=floorf(fminf(ax,bx)-thickness);x<=ceilf(fmaxf(ax,bx)+thickness);x++){
 float t=len?fminf(1,fmaxf(0,((x+.5f-ax)*dx+(y+.5f-ay)*dy)/len)):0;
 float d=hypotf(x+.5f-ax-t*dx,y+.5f-ay-t*dy);
 float a=fminf(1,fmaxf(0,thickness*.5f+.5f-d));if(a>0)pixel(x+(int)content_dx,y,c,lroundf(a*255));}}
static void device_icon(int kind,float cx,float y,uint16_t c){
 if(!kind){icon_stroke(cx,y+5,cx,y+17,10,c);
 icon_stroke(cx-10,y+13,cx-10,y+20,2.3f,c);icon_stroke(cx+10,y+13,cx+10,y+20,2.3f,c);
 icon_stroke(cx-10,y+20,cx-6,y+25,2.3f,c);icon_stroke(cx-6,y+25,cx+6,y+25,2.3f,c);icon_stroke(cx+6,y+25,cx+10,y+20,2.3f,c);
 icon_stroke(cx,y+25,cx,y+30,2.3f,c);icon_stroke(cx-6,y+30,cx+6,y+30,2.3f,c);
 }else{icon_stroke(cx,y+9,cx,y+24,20,c);icon_stroke(cx,y+9,cx,y+24,16,color(0,0,0));
 dot(cx,y+7,2,c);icon_stroke(cx-4,y+18,cx+4,y+18,2,c);icon_stroke(cx,y+14,cx,y+22,2,c);}}
static void coding_mark(void){uint16_t c=color(141,170,170);
 icon_stroke(408,32,419,41,3,c);icon_stroke(419,41,408,50,3,c);icon_stroke(426,50,438,50,3,c);
}
#include "miku_sprite.h"
static uint32_t next(const char **s){const unsigned char *p=(const unsigned char*)*s;uint32_t c=*p++;int n=c<128?0:(c&224)==192?1:(c&240)==224?2:3;c&=n?((1<<(6-n))-1):127;while(n--){if((*p&192)!=128){*s=(const char*)p;return '?';}c=(c<<6)|(*p++&63);}*s=(const char*)p;return c;}
static const glyph_t *glyph(uint32_t c){int lo=0,hi=sizeof(glyphs)/sizeof(glyphs[0])-1;while(lo<=hi){int m=(lo+hi)/2;if(glyphs[m].code==c)return glyphs+m;if(glyphs[m].code<c)lo=m+1;else hi=m-1;}return NULL;}
// 20px header font, bilinear coverage downsampling from the existing atlas.
static void small_text(const char *s,int x,int y,uint16_t color_value){
 while(*s){const glyph_t *g=glyph(next(&s));if(!g)g=glyph('?');if(!g)continue;
 unsigned char raw[32*38]={0};unsigned pos=0;
 for(unsigned k=0;k<g->length;k++){unsigned t=glyph_data[g->offset+k];for(unsigned n=0;n<(t&15)+1&&pos<sizeof raw;n++)raw[pos++]=(t>>4)*17;}
 for(int j=0;j<26;j++)for(int i=0;i<22;i++){float sx=(i+.5f)/.68f-.5f,sy=(j+.5f)/.68f-.5f;int ix=floorf(sx),iy=floorf(sy);float fx=sx-ix,fy=sy-iy,alpha=0;
  for(int dy=0;dy<2;dy++)for(int dx=0;dx<2;dx++)if(ix+dx>=0&&ix+dx<32&&iy+dy>=0&&iy+dy<38)alpha+=raw[(iy+dy)*32+ix+dx]*(dx?fx:1-fx)*(dy?fy:1-fy);
  pixel(x+i,y+j,color_value,lroundf(alpha));}
 x+=lroundf(g->advance*.68f);
 }
}
static int width(const char *s,int scale){int w=0;while(*s){uint32_t c=next(&s);w+=(glyph(c)?glyph(c)->advance:24)*scale;}return w;}
static void text(const char *s,float x,float y,uint16_t c,int scale){while(*s){uint32_t cp=next(&s);const glyph_t *g=glyph(scale==2?cp+0xe000:cp);if(!g)g=glyph('?');int stride=scale==2?64:32;if(g){int pos=0;for(unsigned k=0;k<g->length;k++){unsigned token=glyph_data[g->offset+k],n=(token&15)+1,coverage=(token>>4)*17;for(unsigned j=0;j<n;j++,pos++)if(coverage){unsigned saved=content_alpha;content_alpha=saved*coverage/255;rect(x+(pos%stride),y+(pos/stride),1,1,c);content_alpha=saved;}}}x+=(g?g->advance:32);}}
static void center(const char *s,int y,uint16_t c,int scale){text(s,(480-width(s,scale))*.5f,y,c,scale);}
// Slightly larger task font, bilinear coverage resampling (30 -> 34 px).
static int large_width(const char *s){int w=0;while(*s){const glyph_t *g=glyph(next(&s));w+=lroundf((g?g->advance:32)*34.f/30);}return w;}
static void large(const char *s,int y,uint16_t c){float x=(480-large_width(s))*.5f;while(*s){const glyph_t *g=glyph(next(&s));if(!g)g=glyph('?');if(!g)continue;
 static struct {const glyph_t *g;unsigned char alpha[37*44];} cache[64];static unsigned cursor;
 unsigned slot=0;while(slot<64&&cache[slot].g!=g)slot++;if(slot==64){slot=cursor++%64;cache[slot].g=g;unsigned char raw[32*38]={0};int pos=0;for(unsigned k=0;k<g->length;k++){unsigned t=glyph_data[g->offset+k];for(unsigned n=0;n<(t&15)+1&&pos<32*38;n++)raw[pos++]=(t>>4)*17;}
 for(int j=0;j<44;j++)for(int i=0;i<37;i++){float sx=(i+.5f)*30/34-.5f,sy=(j+.5f)*30/34-.5f;int ix=floorf(sx),iy=floorf(sy);float fx=sx-ix,fy=sy-iy,sum=0;for(int dy=0;dy<2;dy++)for(int dx=0;dx<2;dx++)if(ix+dx>=0&&ix+dx<32&&iy+dy>=0&&iy+dy<38)sum+=raw[(iy+dy)*32+ix+dx]*(dx?fx:1-fx)*(dy?fy:1-fy);cache[slot].alpha[j*37+i]=lroundf(sum);}}
 for(int j=0;j<44;j++){for(int i=0;i<37;i++){if(cache[slot].alpha[j*37+i]){unsigned saved=content_alpha;content_alpha=saved*cache[slot].alpha[j*37+i]/255;rect(x+i,y+j,1,1,c);content_alpha=saved;}}}
 x+=lroundf(g->advance*34.f/30);}}
static void large_wrap(const char *s,int y,uint16_t c){int lines=y>=370?1:4;for(int line=0;line<lines&&*s;line++){char row[200];int n=0,w=0;while(*s){if(*s=='\n'){s++;break;}const char *p=s;uint32_t cp=next(&p);int cw=lroundf((glyph(cp)?glyph(cp)->advance:32)*34.f/30);if(w+cw>(y>=370?238:380))break;int len=p-s;if(n+len>180)break;memcpy(row+n,s,len);n+=len;s=p;w+=cw;}row[n]=0;if(line==lines-1&&*s){while(n&&large_width(row)>(y>=370?203:345)){do{n--;}while(n&&((unsigned char)row[n]&192)==128);row[n]=0;}strcat(row,"...");}large(row,y+line*40,c);}}
static void card_text(const char *s,int cx,int y,uint16_t c,int scale){int w=0;for(const char *p=s;*p;){uint32_t cp=next(&p);const glyph_t *g=glyph(scale==2?cp+0xe000:cp);w+=g?g->advance:32;}text(s,cx-w*.5f,y,c,scale);}
static void copy(char *out,size_t n,const cJSON *o,const char *key){const cJSON *v=cJSON_GetObjectItemCaseSensitive(o,key);const char *s=cJSON_IsString(v)?v->valuestring:"";size_t used=0;while(*s){const char *end=s;next(&end);size_t bytes=end-s;if(used+bytes>=n)break;memcpy(out+used,s,bytes);used+=bytes;s=end;}out[used]=0;}
void dashboard_init(void){glyph_data=heap_caps_malloc(GLYPH_DATA_SIZE,MALLOC_CAP_SPIRAM);configASSERT(glyph_data);tinfl_decompressor *decoder=heap_caps_calloc(1,sizeof(*decoder),MALLOC_CAP_SPIRAM);configASSERT(decoder);tinfl_init(decoder);size_t input_size=sizeof(glyph_compressed),output_size=GLYPH_DATA_SIZE;configASSERT(tinfl_decompress(decoder,glyph_compressed,&input_size,glyph_data,glyph_data,&output_size,TINFL_FLAG_PARSE_ZLIB_HEADER|TINFL_FLAG_USING_NON_WRAPPING_OUTPUT_BUF)==TINFL_STATUS_DONE);configASSERT(output_size==GLYPH_DATA_SIZE);free(decoder);lock=xSemaphoreCreateMutex();canvas=heap_caps_calloc(480*480,2,MALLOC_CAP_SPIRAM);band=heap_caps_malloc(480*BAND_ROWS*2,MALLOC_CAP_SPIRAM);previous=heap_caps_malloc(480*480*2,MALLOC_CAP_SPIRAM);text_cache=heap_caps_calloc(400*365,2,MALLOC_CAP_SPIRAM);configASSERT(lock&&canvas&&band&&previous&&text_cache);memset(previous,0xff,480*480*2);border_init();miku_init();}
static int battery_number(const cJSON *v,int max){return cJSON_IsNumber(v)&&v->valuedouble>=0&&v->valuedouble<=max&&floor(v->valuedouble)==v->valuedouble?v->valueint:-1;}
void dashboard_update(const cJSON *json){
 if(!cJSON_IsObject(json))return;
 xSemaphoreTake(lock,portMAX_DELAY);data.count=0;data.agent_count=0;
 const cJSON *battery=cJSON_GetObjectItemCaseSensitive(json,"battery"),*bars=cJSON_GetObjectItemCaseSensitive(battery,"mic_bars");
 for(int i=0;i<2;i++)data.mic[i]=battery_number(cJSON_GetArrayItem(bars,i),7);
 data.remote=battery_number(cJSON_GetObjectItemCaseSensitive(battery,"remote_percent"),100);
 data.available=cJSON_IsTrue(cJSON_GetObjectItemCaseSensitive(json,"tasks_available"));copy(data.platform,sizeof data.platform,json,"platform");
 const cJSON *v,*a=cJSON_GetObjectItemCaseSensitive(json,"providers");
 cJSON_ArrayForEach(v,a){if(data.agent_count==4)break;agent_t *p=&data.agents[data.agent_count++];memset(p,0,sizeof *p);
  copy(p->id,sizeof p->id,v,"id");copy(p->label,sizeof p->label,v,"label");p->weekly=battery_number(cJSON_GetObjectItemCaseSensitive(v,"weekly_percent"),100);
  p->has_five_hour=cJSON_IsTrue(cJSON_GetObjectItemCaseSensitive(v,"five_hour_available"));p->five_hour=battery_number(cJSON_GetObjectItemCaseSensitive(v,"five_hour_percent"),100);
  p->reset=battery_number(cJSON_GetObjectItemCaseSensitive(v,"five_hour_reset_seconds"),18000);
 }
 a=cJSON_GetObjectItemCaseSensitive(json,"tasks");cJSON_ArrayForEach(v,a){if(data.count==4)break;task_t *t=&data.tasks[data.count++];
  copy(t->name,sizeof t->name,v,"name");copy(t->summary,sizeof t->summary,v,"summary");copy(t->state,sizeof t->state,v,"state");copy(t->platform,sizeof t->platform,v,"platform");}
 data.at=esp_timer_get_time()/1000000;xSemaphoreGive(lock);
}
void dashboard_gravity(float x,float y){uint32_t now=esp_timer_get_time()/1000;float ax=fabsf(x),ay=fabsf(y);if(fmaxf(ax,ay)<60000||fmaxf(ax,ay)<fminf(ax,ay)*1.3f){proposed_at=now;return;}int r=ax>ay?(x>0?3:1):(y>0?0:2);if(r!=proposed){proposed=r;proposed_at=now;}else if(now-proposed_at>650)atomic_store(&rotation,r);}
void dashboard_next(void){atomic_fetch_add(&selected,1);}
static const char *state_label(const char *s){if(!strcmp(s,"running"))return "正在工作";if(!strcmp(s,"attention"))return "等待你回复";if(!strcmp(s,"done"))return "任务完成";if(!strcmp(s,"failed"))return "任务失败";if(!strcmp(s,"paused"))return "已暂停";return "等待新任务";}
void dashboard_frame(void){
 uint32_t now=esp_timer_get_time()/1000000;float seconds=esp_timer_get_time()*1e-6f;int frame=(int)(seconds*9)%12;
 task_t task={0};agent_t agent={0};int count,mic[2],remote;bool online,available,has_agent=false;
 xSemaphoreTake(lock,portMAX_DELAY);count=data.count;mic[0]=data.mic[0];mic[1]=data.mic[1];remote=data.remote;online=data.at&&now-data.at<15;available=online&&data.available;if(count)task=data.tasks[atomic_load(&selected)%count];
 const char *platform=task.platform[0]?task.platform:data.platform;
 for(int i=0;i<data.agent_count;i++)if(!strcmp(data.agents[i].id,platform)){agent=data.agents[i];has_agent=true;break;}
 if(!has_agent&&data.agent_count){agent=data.agents[0];has_agent=true;}
 xSemaphoreGive(lock);
 quota_view_t q=quota_snapshot(now);if(has_agent)q=(quota_view_t){online?agent.weekly:-1,!online||agent.weekly<0};uint16_t white=color(243,235,210),muted=color(150,166,168),green=color(184,222,213),cyan=color(184,222,213),yellow=color(237,218,173),red=color(222,160,155),track=color(53,65,72);
 uint16_t accent=!strcmp(task.state,"attention")?yellow:!strcmp(task.state,"failed")?red:!strcmp(task.state,"done")?green:cyan;
 uint16_t background=color(20,25,28);for(int i=0;i<480*480;i++)canvas[i]=background;
 uint16_t qc=q.stale?muted:q.percent<15?red:q.percent<35?yellow:green;
 unsigned progress=q.percent<0?0:(unsigned)q.percent*65535/100;
 float glow_phase=fmodf(seconds,16.f);bool glow_active=false;unsigned glow_peak=glow_active?lroundf(75*sinf(glow_phase*3.14159265f/5)):0;unsigned head=progress?(unsigned)(glow_phase/5*progress):0;unsigned trail=progress<13000?progress/2:6500;
 for(int i=0;i<border_count;i++){unsigned tail=head>=border[i].progress?head-border[i].progress:65535;uint16_t base=border[i].progress<=progress?qc:track;
 if(glow_active&&!q.stale&&q.percent>0&&border[i].progress<=progress&&trail&&tail<trail){unsigned strength=(trail-tail)*glow_peak/trail;unsigned a=(base>>8)|(base<<8),b=(white>>8)|(white<<8);unsigned v=(((((a>>11)&31)*(255-strength)+((b>>11)&31)*strength)/255)<<11)|(((((a>>5)&63)*(255-strength)+((b>>5)&63)*strength)/255)<<5)|(((a&31)*(255-strength)+(b&31)*strength)/255);base=(v>>8)|(v<<8);}
 canvas[border[i].index]=fade(base,border[i].alpha);}
 content_dx=0;content_alpha=255;
 dot(140,14,5,color(53,65,72));dot(14,80,5,color(53,65,72));
 if(q.percent>0&&!q.stale){
  const float straight=368,arc=42*1.570796327f,quarter=straight+arc,total=quarter*4;
  float path=fmodf((total-174)*q.percent/100.f+84,total),v=path;int side=(int)(v/quarter);v-=side*quarter;
  float x,y;if(v<straight){x=56+v;y=14;}else{float a=(v-straight)/42-1.570796327f;x=424+42*cosf(a);y=56+42*sinf(a);}
  float px=x,py=y;if(side==1){px=480-y;py=x;}else if(side==2){px=480-x;py=480-y;}else if(side==3){px=y;py=480-x;}
  dot(140,14,5,qc);dot(px,py,5,qc);
 }
 uint16_t violet=color(199,185,218),aqua=color(184,222,213);
 int slot=mic[0]>=0?0:1;if(mic[0]>=0&&mic[1]>=0)slot=((int)seconds/5)%2;int mic_level=online?mic[slot]:-1;
 segmented_bar(62,280,7,mic_level<0?0:mic_level/7.f,aqua);segmented_bar(394,280,10,online&&remote>=0?remote/100.f:0,violet);

 char line[100];if(q.percent<0||q.stale)snprintf(line,sizeof line,"--");else snprintf(line,sizeof line,"%d",q.percent);pretty_number(line,qc);coding_mark();small_text("7d",126,48,muted);
 if(has_agent&&online&&agent.has_five_hour){
  small_text(agent.label,168,17,muted);char amount[16],reset[16];
  if(agent.five_hour<0)snprintf(amount,sizeof amount,"--");else snprintf(amount,sizeof amount,"%d%%",agent.five_hour);
  if(agent.reset<0)snprintf(reset,sizeof reset,"--:--");else snprintf(reset,sizeof reset,"%02d:%02d",agent.reset/3600,agent.reset%3600/60);
  snprintf(line,sizeof line,"5h %s  %s",amount,reset);small_text(line,168,43,agent.five_hour>=0&&agent.five_hour<15?red:white);
 }else if(has_agent)text(agent.label,168,28,muted,1);

 device_icon(0,74,239,aqua);device_icon(1,406,239,violet);
 if(mic_level<0)snprintf(line,sizeof line,"--");else snprintf(line,sizeof line,"%d/7",mic_level);card_text(line,74,424,white,1);
 if(!online||remote<0)snprintf(line,sizeof line,"--");else snprintf(line,sizeof line,"%d%%",remote);card_text(line,406,424,white,1);
 static int last_selected=-1;static float transition_start=-1;
 int selection=atomic_load(&selected);if(selection!=last_selected){if(last_selected>=0)transition_start=seconds;last_selected=selection;}
 float transition=fminf(1,fmaxf(0,(seconds-transition_start)/.28f));float ease=1-powf(1-transition,3);
 content_dx=(1-ease)*42;content_alpha=80+175*ease;
 bool run=available&&!strcmp(task.state,"running");
 const char *name=available&&count?task.name:available?"暂无活跃任务":"任务数据未连接";
 const char *status=online?(available?(count?(run&&task.summary[0]?task.summary:state_label(task.state)):"等待新任务"):"任务同步中"):"电脑连接中断";
 static char saved_name[200],saved_status[300];static uint16_t saved_color;static bool cached;
 uint16_t status_color=online?accent:yellow;
 if(transition<1||!cached||strcmp(name,saved_name)||strcmp(status,saved_status)||status_color!=saved_color){large_wrap(name,76,white);large_wrap(status,380,status_color);cached=transition>=1;if(cached){snprintf(saved_name,sizeof saved_name,"%s",name);snprintf(saved_status,sizeof saved_status,"%s",status);saved_color=status_color;for(int y=75;y<440;y++){if(y>=232&&y<380)continue;if(y>=419)continue;int left=y>=380?116:40,w=y>=380?248:400;memcpy(text_cache+(y-75)*400,canvas+y*480+left,w*2);}}}
 else {for(int y=75;y<440;y++){if(y>=232&&y<380)continue;if(y>=419)continue;int left=y>=380?116:40,w=y>=380?248:400;memcpy(canvas+y*480+left,text_cache+(y-75)*400,w*2);}}
 int pet_state=!online||!available?4:run?(strstr(task.summary,"检查")||strstr(task.summary,"分析")?6:5):!strcmp(task.state,"attention")?1:!strcmp(task.state,"done")?2:!strcmp(task.state,"failed")?3:!strcmp(task.state,"paused")?4:0;
 draw_miku(pet_state,seconds);
 content_dx=0;content_alpha=255;
 if(count>1)for(int i=0;i<count;i++)dot(240+(i*2-count+1)*12,444,i==selection%count?4:3,i==selection%count?white:track);
 unsigned pin=quota_setup_pin();if(pin){rect(40,105,400,320,0);center("请连接配网热点",136,yellow,1);center("FLUIDBOX-SETUP",173,white,1);snprintf(line,sizeof line,"密码 %08u",pin);center(line,213,white,1);center("192.168.4.1",253,cyan,1);center("长按 BOOT 三秒重新配网",305,muted,1);}
 int r=atomic_load(&rotation);for(int b=0;b<BAND_COUNT;b++){
 int left=480,right=0;
 if(r==0){for(int j=0;j<BAND_ROWS;j++){int y=b*BAND_ROWS+j;uint16_t *src=canvas+y*480,*dst=previous+y*480;
  if(!memcmp(src,dst,480*2))continue;
  for(int x=0;x<480;x+=16)if(memcmp(src+x,dst+x,32)){if(x<left)left=x;if(x+16>right)right=x+16;}
  memcpy(dst,src,480*2);
 }}else for(int j=0;j<BAND_ROWS;j++)for(int x=0;x<480;x++){int y=b*BAND_ROWS+j,sx=x,sy=y;if(r==1){sx=y;sy=479-x;}else if(r==2){sx=479-x;sy=479-y;}else if(r==3){sx=479-y;sy=x;}uint16_t pixel=canvas[sy*480+sx];if(previous[y*480+x]!=pixel){if(x<left)left=x;if(x+1>right)right=x+1;}previous[y*480+x]=pixel;}
 if(right>left){left=left/16*16;right=(right+15)/16*16;int w=right-left;for(int j=0;j<BAND_ROWS;j++)memcpy(band+j*w,previous+(b*BAND_ROWS+j)*480+left,w*2);display_stage_band(b,left,right,band);}}
 display_present();
}
